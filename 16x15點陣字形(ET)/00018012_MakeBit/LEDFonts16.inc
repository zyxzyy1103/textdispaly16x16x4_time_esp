;
;16x16中文字形：歡, Data15->Data0,Scan0->Scan15
         DB      000h,000h,008h,004h,006h,074h,0FFh,0DEh
         DB      055h,074h,055h,084h,07Fh,074h,055h,05Eh
         DB      055h,074h,080h,084h,060h,060h,018h,01Eh
         DB      007h,0D2h,018h,010h,060h,050h,080h,038h
;
;16x16中文字形：迎, Data15->Data0,Scan0->Scan15
         DB      000h,000h,082h,010h,062h,022h,01Fh,024h
         DB      022h,004h,044h,000h,04Fh,0FEh,084h,004h
         DB      082h,002h,081h,002h,080h,000h,0BFh,0FEh
         DB      084h,004h,08Ch,004h,047h,0FEh,040h,004h
;
;16x16中文字形：蒞, Data15->Data0,Scan0->Scan15
         DB      000h,000h,048h,044h,0F8h,094h,006h,024h
         DB      001h,084h,002h,04Eh,001h,004h,0FFh,0C4h
         DB      000h,034h,080h,054h,086h,04Eh,0B8h,044h
         DB      080h,074h,0F0h,054h,08Eh,046h,082h,044h
;
;16x16中文字形：臨, Data15->Data0,Scan0->Scan15
         DB      000h,000h,07Fh,0FEh,022h,044h,03Eh,07Ch
         DB      022h,046h,027h,0E4h,020h,044h,0FCh,020h
         DB      044h,018h,045h,0EEh,0FDh,02Ah,001h,028h
         DB      0FDh,028h,045h,0E8h,044h,00Ch,0FCh,008h
;
;16x16中文字形：崇, Data15->Data0,Scan0->Scan15
         DB      
         DB      000h,000h,045h,000h,044h,0E0h,024h,04Eh
         DB      015h,04Ah,015h,048h,045h,048h,0C5h,048h
         DB      07Dh,06Eh,005h,04Ah,005h,048h,015h,048h
         DB      024h,048h,064h,04Eh,006h,0E2h,004h,040h
;
;16x16中文字形：實, Data15->Data0,Scan0->Scan15
         DB      000h,000h,000h,010h,000h,00Eh,080h,014h
         DB      0FFh,014h,055h,07Ch,055h,054h,055h,054h
         DB      055h,07Ch,055h,056h,055h,054h,055h,07Ch
         DB      0FFh,014h,080h,014h,000h,00Eh,000h,004h
;
;16x16中文字形：高, Data15->Data0,Scan0->Scan15
         DB      000h,000h,000h,008h,0FFh,008h,002h,008h
         DB      002h,0E8h,03Ah,0A8h,02Ah,0A8h,02Ah,0A8h
         DB      02Ah,0AEh,02Ah,0AAh,03Ah,0A8h,002h,0E8h
         DB      042h,008h,0C2h,008h,07Fh,00Ch,002h,008h
;
;16x16中文字形：工, Data15->Data0,Scan0->Scan15
         DB      000h,000h,040h,000h,040h,008h,040h,008h
         DB      040h,008h,040h,008h,040h,008h,040h,008h
         DB      07Fh,0F8h,040h,008h,040h,008h,040h,008h
         DB      040h,008h,040h,00Ch,060h,008h,040h,000h
;
;16x16中文字形：資, Data15->Data0,Scan0->Scan15
         DB      000h,000h,000h,024h,080h,064h,080h,024h
         DB      0BFh,094h,06Ah,090h,02Ah,088h,02Ah,0D0h
         DB      02Ah,0CCh,02Ah,0A6h,02Ah,0A4h,02Ah,09Ch
         DB      06Ah,0A4h,0BFh,0A4h,080h,04Ch,080h,044h
;
;16x16中文字形：訊, Data15->Data0,Scan0->Scan15
         DB      000h,000h,000h,010h,0FDh,054h,049h,054h
         DB      049h,054h,049h,056h,0FDh,054h,080h,010h
         DB      081h,004h,061h,004h,01Fh,0FCh,010h,004h
         DB      000h,004h,01Fh,0FEh,060h,004h,0FCh,000h
;
;16x16中文字形：科, Data15->Data0,Scan0->Scan15
         DB      000h,000h,008h,024h,006h,024h,001h,0A4h
         DB      0FFh,0FEh,001h,022h,006h,032h,000h,020h
         DB      008h,084h,009h,008h,00Bh,018h,008h,000h
         DB      0FFh,0FEh,004h,002h,006h,000h,004h,000h
;
         DB      0FFh,0FFh
;
;16x16中文字形：黃, Data15->Data0,Scan0->Scan15
         DB      000h,000h,080h,044h,080h,044h,05Fh,044h
         DB      055h,044h,035h,044h,015h,05Eh,015h,054h
         DB      01Fh,0D4h,015h,054h,015h,05Eh,035h,044h
         DB      055h,044h,05Fh,044h,0C0h,066h,000h,044h
;
;16x16中文字形：章, Data15->Data0,Scan0->Scan15
         DB      000h,000h,020h,020h,020h,024h,020h,024h
         DB      02Fh,0A4h,02Ah,0ACh,02Ah,0B4h,02Ah,0A4h
         DB      0FAh,0A6h,02Ah,0A4h,02Ah,0B4h,02Ah,0ACh
         DB      02Fh,0A4h,020h,026h,030h,024h,020h,020h
;
;16x16中文字形：銘, Data15->Data0,Scan0->Scan15
         DB      000h,000h,045h,040h,0D9h,020h,041h,038h
         DB      07Fh,0E6h,029h,022h,025h,02Ch,008h,050h
         DB      008h,040h,0FCh,030h,046h,0DEh,045h,012h
         DB      044h,0D0h,044h,038h,0FEh,010h,004h,000h
;
;16x16中文字形：休, Data15->Data0,Scan0->Scan15
         DB      000h,000h,000h,080h,000h,040h,0FFh,0F0h
         DB      000h,02Eh,010h,002h,008h,020h,006h,020h
         DB      001h,0A0h,000h,060h,0FFh,0FEh,000h,0A2h
         DB      003h,020h,00Ch,020h,018h,030h,008h,020h
;
;16x16中文字形：公, Data15->Data0,Scan0->Scan15
         DB      000h,000h,042h,000h,0C1h,000h,040h,0C0h
         DB      060h,038h,058h,008h,047h,000h,041h,004h
         DB      020h,004h,024h,00Eh,028h,034h,010h,040h
         DB      060h,080h,0C1h,000h,003h,000h,001h,000h
;
;16x16中文字形：假, Data15->Data0,Scan0->Scan15
         DB      000h,000h,000h,080h,000h,040h,0FFh,0F0h
         DB      000h,00Eh,000h,000h,0FFh,0FEh,012h,024h
         DB      01Bh,024h,012h,07Eh,080h,000h,04Eh,024h
         DB      032h,024h,012h,024h,06Fh,07Eh,082h,004h
;
;16x16中文字形：評, Data15->Data0,Scan0->Scan15
         DB      000h,000h,000h,010h,0FDh,054h,049h,054h
         DB      049h,054h,049h,056h,0FDh,054h,008h,010h
         DB      005h,084h,004h,064h,004h,004h,0FFh,0FCh
         DB      004h,004h,004h,066h,005h,084h,004h,000h
;
;16x16中文字形：選, Data15->Data0,Scan0->Scan15
         DB      000h,000h,0C2h,010h,042h,022h,03Fh,024h
         DB      022h,004h,040h,000h,048h,03Eh,0AAh,04Ah
         DB      0AAh,04Ah,09Fh,06Eh,08Ah,000h,08Ah,03Eh
         DB      09Fh,04Ah,0AAh,04Ah,0AAh,06Eh,088h,000h
;
;16x16中文字形：國, Data15->Data0,Scan0->Scan15
         DB      000h,000h,000h,000h,0FFh,0FEh,040h,004h
         DB      04Bh,0A4h,04Ah,0A4h,04Ah,0A4h,04Bh,0A4h
         DB      050h,024h,049h,0FCh,046h,024h,049h,0ACh
         DB      05Ch,0B4h,040h,004h,0FFh,0FEh,000h,004h
;
;16x16中文字形：民, Data15->Data0,Scan0->Scan15
         DB      000h,000h,020h,000h,060h,000h,03Fh,0FEh
         DB      021h,024h,011h,024h,011h,024h,011h,024h
         DB      009h,024h,001h,0E4h,007h,024h,019h,024h
         DB      021h,024h,041h,07Eh,0F9h,004h,041h,000h
;
;16x16中文字形：旅, Data15->Data0,Scan0->Scan15
         DB      000h,000h,0E0h,010h,01Fh,0F0h,040h,090h
         DB      0C0h,09Eh,07Fh,0D2h,000h,090h,040h,040h
         DB      0C0h,030h,07Fh,09Eh,020h,092h,020h,050h
         DB      007h,0D0h,018h,050h,066h,018h,082h,010h
;
;16x16中文字形：遊, Data15->Data0,Scan0->Scan15
         DB      000h,000h,0C2h,010h,042h,022h,03Fh,024h
         DB      022h,004h,058h,010h,047h,0F0h,090h,09Eh
         DB      0B0h,092h,09Fh,090h,080h,020h,092h,01Eh
         DB      0B2h,04Ah,09Fh,048h,042h,0CCh,042h,008h
;
;16x16中文字形：黃, Data15->Data0,Scan0->Scan15
         DB      000h,000h,080h,044h,080h,044h,05Fh,044h
         DB      055h,044h,035h,044h,015h,05Eh,015h,054h
         DB      01Fh,054h,015h,054h,015h,05Eh,035h,044h
         DB      055h,044h,05Fh,044h,0C0h,066h,000h,044h
;
;16x16中文字形：章, Data15->Data0,Scan0->Scan15
         DB      000h,000h,020h,020h,020h,024h,020h,024h
         DB      02Fh,0A4h,02Ah,0ACh,02Ah,0B4h,02Ah,0A4h
         DB      0FAh,0A6h,02Ah,0A4h,02Ah,0B4h,02Ah,0ACh
         DB      02Fh,0A4h,020h,026h,030h,024h,020h,020h
;
;16x16中文字形：銘, Data15->Data0,Scan0->Scan15
         DB      000h,000h,045h,040h,0D9h,020h,041h,038h
         DB      07Fh,0E6h,029h,022h,025h,02Ch,008h,050h
         DB      008h,040h,0FCh,030h,046h,0DEh,045h,012h
         DB      044h,0D0h,044h,038h,0FEh,010h,004h,000h
;
;16x16中文字形：愛, Data15->Data0,Scan0->Scan15
         DB      000h,000h,000h,0C0h,082h,034h,091h,0A4h
         DB      090h,02Ch,049h,0B4h,05Eh,024h,02Ah,066h
         DB      02Ah,0BAh,02Ah,0A2h,05Ah,032h,04Bh,02Eh
         DB      080h,026h,080h,0A2h,083h,070h,000h,020h
;
;16x16中文字形：葉, Data15->Data0,Scan0->Scan15
         DB      000h,000h,048h,024h,048h,024h,048h,024h
         DB      04Bh,0F4h,02Ah,02Eh,02Ah,024h,01Ah,0F4h
         DB      0FEh,0A4h,02Ah,0A4h,02Ah,0AEh,02Ah,0F4h
         DB      04Ah,024h,04Bh,034h,04Ah,026h,048h,004h
;
;16x16中文字形：靜, Data15->Data0,Scan0->Scan15
         DB      000h,000h,000h,044h,0FFh,054h,009h,054h
         DB      04Fh,07Eh,0C9h,054h,07Fh,054h,000h,044h
         DB      001h,020h,045h,05Ch,0C5h,044h,07Fh,0C4h
         DB      005h,05Ah,005h,042h,00Fh,0CAh,001h,032h
;
;16x16中文字形：蓉, Data15->Data0,Scan0->Scan15
         DB      000h,000h,010h,084h,012h,074h,009h,024h
         DB      004h,0A4h,0FCh,0AEh,04Ah,024h,049h,0A4h
         DB      048h,0B4h,049h,024h,04Ah,024h,0FCh,0AEh
         DB      004h,0A4h,009h,024h,00Bh,076h,008h,024h
;
;16x16中文字形：，, Data15->Data0,Scan0->Scan15
         DB      000h,000h,000h,000h,000h,000h,000h,000h
         DB      000h,000h,000h,000h,000h,000h,004h,0C0h
         DB      003h,0C0h,000h,000h,000h,000h,000h,000h
         DB      000h,000h,000h,000h,000h,000h,000h,000h
;
;16x16中文字形：粉, Data15->Data0,Scan0->Scan15
         DB      000h,000h,018h,088h,006h,0B0h,001h,080h
         DB      0FFh,0FEh,002h,0A2h,00Ch,098h,081h,000h
         DB      040h,0C0h,031h,038h,00Fh,000h,041h,004h
         DB      0C1h,01Eh,07Fh,064h,000h,080h,001h,000h
;
;16x16中文字形：愛, Data15->Data0,Scan0->Scan15
         DB      000h,000h,000h,0C0h,082h,034h,091h,0A4h
         DB      090h,02Ch,049h,0B4h,05Eh,024h,02Ah,066h
         DB      02Ah,0BAh,02Ah,0A2h,05Ah,032h,04Bh,02Eh
         DB      080h,026h,080h,0A2h,083h,070h,000h,020h
;
;16x16中文字形：喔, Data15->Data0,Scan0->Scan15
         DB      000h,000h,00Fh,0FCh,002h,008h,002h,008h
         DB      0C7h,0FCh,070h,000h,00Fh,0FEh,080h,014h
         DB      092h,054h,097h,054h,092h,0D4h,0FAh,054h
         DB      092h,0D4h,091h,05Eh,0D2h,044h,080h,000h
;
;16x16中文字形：！, Data15->Data0,Scan0->Scan15
         DB      000h,000h,000h,000h,000h,000h,000h,000h
         DB      000h,000h,000h,000h,000h,000h,030h,03Ch
         DB      037h,0FCh,000h,000h,000h,000h,000h,000h
         DB      000h,000h,000h,000h,000h,000h,000h,000h
;
;16x16中文字形：請, Data15->Data0,Scan0->Scan15
         DB      000h,000h,000h,010h,0FDh,054h,049h,054h
         DB      049h,054h,049h,056h,0FDh,054h,008h,010h
         DB      000h,044h,0FFh,054h,009h,054h,00Fh,07Eh
         DB      049h,054h,0C9h,054h,07Fh,054h,000h,044h
;
;16x16中文字形：補, Data15->Data0,Scan0->Scan15
         DB      000h,000h,004h,010h,002h,010h,001h,01Eh
         DB      0FFh,0D2h,001h,038h,006h,090h,000h,000h
         DB      0FFh,0E8h,009h,048h,009h,048h,0FFh,0FEh
         DB      049h,048h,0C9h,04Ah,07Fh,0ECh,000h,048h
;
;16x16中文字形：對, Data15->Data0,Scan0->Scan15
         DB      000h,000h,042h,024h,0CAh,0A8h,04Ah,0A0h
         DB      04Bh,03Eh,07Eh,020h,02Bh,03Eh,02Ah,0A8h
         DB      02Ah,0A4h,000h,000h,003h,020h,04Ch,020h
         DB      0C0h,020h,07Fh,0FEh,000h,022h,000h,020h
;
;16x16中文字形：年, Data15->Data0,Scan0->Scan15
         DB      000h,000h,008h,040h,008h,020h,008h,018h
         DB      00Fh,0CEh,008h,08Ah,008h,088h,008h,088h
         DB      008h,088h,0FFh,0F8h,008h,088h,008h,088h
         DB      008h,0C8h,008h,08Ch,00Ch,008h,008h,000h
;
;16x16中文字形：0(半形), Data15->Data0,Scan0->Scan15
         DB      000h,000h,00Fh,0F0h,010h,008h,020h,004h
         DB      020h,004h,010h,008h,00Fh,0F0h,000h,000h
;
;16x16中文字形：1(半形), Data15->Data0,Scan0->Scan15
         DB      000h,000h,000h,000h,000h,000h,020h,008h
         DB      03Fh,0FCh,020h,000h,000h,000h,000h,000h
;
;16x16中文字形：2(半形), Data15->Data0,Scan0->Scan15
         DB      000h,000h,030h,018h,028h,004h,024h,004h
         DB      022h,004h,021h,088h,030h,070h,000h,000h
;
;16x16中文字形：3(半形), Data15->Data0,Scan0->Scan15
         DB      000h,000h,020h,008h,020h,004h,020h,084h
         DB      020h,0C4h,011h,038h,00Eh,000h,000h,000h
;
;16x16中文字形：4(半形), Data15->Data0,Scan0->Scan15
         DB      000h,000h,006h,000h,005h,080h,004h,060h
         DB      004h,018h,03Fh,0FCh,004h,000h,000h,000h
;
;16x16中文字形：5(半形), Data15->Data0,Scan0->Scan15
         DB      000h,000h,020h,000h,020h,07Ch,020h,044h
         DB      020h,044h,010h,084h,00Fh,004h,000h,000h
;
;16x16中文字形：6(半形), Data15->Data0,Scan0->Scan15
         DB      000h,000h,00Fh,0E0h,010h,090h,020h,048h
         DB      020h,044h,010h,084h,00Fh,004h,000h,000h
;
;16x16中文字形：7(半形), Data15->Data0,Scan0->Scan15
         DB      000h,000h,000h,01Ch,000h,004h,038h,004h
         DB      007h,004h,000h,0E4h,000h,01Ch,000h,000h
;
;16x16中文字形：8(半形), Data15->Data0,Scan0->Scan15
         DB      000h,000h,00Eh,030h,011h,048h,020h,084h
         DB      020h,084h,011h,048h,00Eh,030h,000h,000h
;
;16x16中文字形：9(半形), Data15->Data0,Scan0->Scan15
         DB      000h,000h,020h,0F0h,021h,008h,022h,004h
         DB      012h,004h,009h,008h,007h,0F0h,000h,000h
;
;16x16中文字形：/(半形), Data15->Data0,Scan0->Scan15
         DB      000h,000h,000h,000h,038h,000h,007h,000h
         DB      000h,0E0h,000h,01Ch,000h,000h,000h,000h
;
;16x16中文字形：((半形), Data15->Data0,Scan0->Scan15
         DB      000h,000h,000h,000h,01Fh,0C0h,060h,030h
         DB      080h,008h,000h,004h,000h,000h,000h,000h
;
;16x16中文字形：)(半形), Data15->Data0,Scan0->Scan15
         DB      000h,000h,000h,000h,000h,004h,080h,008h
         DB      060h,030h,01Fh,0C0h,000h,000h,000h,000h
;
;16x16中文字形：W(半形), Data15->Data0,Scan0->Scan15
         DB      000h,004h,003h,0FCh,03Ch,004h,003h,0F0h
         DB      03Ch,004h,003h,0FCh,000h,004h,000h,000h
;
;16x16中文字形：０(全形), Data15->Data0,Scan0->Scan15
         DB      000h,000h,000h,000h,000h,000h,000h,000h
         DB      000h,000h,00Fh,0F0h,010h,008h,020h,004h
         DB      020h,004h,010h,008h,00Fh,0F0h,000h,000h
         DB      000h,000h,000h,000h,000h,000h,000h,000h
;
;16x16中文字形：１(全形), Data15->Data0,Scan0->Scan15
         DB      000h,000h,000h,000h,000h,000h,000h,000h
         DB      000h,000h,020h,008h,020h,008h,03Fh,0FCh
         DB      020h,000h,020h,000h,000h,000h,000h,000h
         DB      000h,000h,000h,000h,000h,000h,000h,000h
;
;16x16中文字形：２(全形), Data15->Data0,Scan0->Scan15
         DB      000h,000h,000h,000h,000h,000h,000h,000h
         DB      000h,000h,038h,038h,024h,004h,022h,004h
         DB      021h,004h,020h,0C4h,038h,078h,000h,000h
         DB      000h,000h,000h,000h,000h,000h,000h,000h
;
;16x16中文字形：３(全形), Data15->Data0,Scan0->Scan15
         DB      000h,000h,000h,000h,000h,000h,000h,000h
         DB      000h,000h,018h,018h,020h,004h,020h,084h
         DB      020h,084h,021h,04Ch,01Eh,038h,000h,000h
         DB      000h,000h,000h,000h,000h,000h,000h,000h
;
;16x16中文字形：４(全形), Data15->Data0,Scan0->Scan15
         DB      000h,000h,000h,000h,000h,000h,000h,000h
         DB      000h,000h,007h,000h,004h,0C0h,024h,030h
         DB      024h,008h,03Fh,0FCh,024h,000h,000h,000h
         DB      000h,000h,000h,000h,000h,000h,000h,000h
;
;16x16中文字形：５(全形), Data15->Data0,Scan0->Scan15
         DB      000h,000h,000h,000h,000h,000h,000h,000h
         DB      000h,000h,018h,0FCh,028h,084h,020h,044h
         DB      020h,044h,030h,084h,01Fh,084h,000h,000h
         DB      000h,000h,000h,000h,000h,000h,000h,000h
;
;16x16中文字形：６(全形), Data15->Data0,Scan0->Scan15
         DB      000h,000h,000h,000h,000h,000h,000h,000h
         DB      000h,000h,00Fh,0E0h,030h,098h,020h,084h
         DB      020h,044h,020h,08Ch,01Fh,008h,000h,000h
         DB      000h,000h,000h,000h,000h,000h,000h,000h
;
;16x16中文字形：７(全形), Data15->Data0,Scan0->Scan15
         DB      000h,000h,000h,000h,000h,000h,000h,000h
         DB      000h,000h,000h,01Ch,030h,004h,03Eh,004h
         DB      001h,084h,000h,064h,000h,01Ch,000h,000h
         DB      000h,000h,000h,000h,000h,000h,000h,000h
;
;16x16中文字形：８(全形), Data15->Data0,Scan0->Scan15
         DB      000h,000h,000h,000h,000h,000h,000h,000h
         DB      000h,000h,01Eh,078h,021h,0C4h,020h,084h
         DB      021h,084h,021h,044h,01Eh,038h,000h,000h
         DB      000h,000h,000h,000h,000h,000h,000h,000h
;
;16x16中文字形：９(全形), Data15->Data0,Scan0->Scan15
         DB      000h,000h,000h,000h,000h,000h,000h,000h
         DB      000h,000h,010h,0F8h,031h,004h,021h,004h
         DB      021h,004h,019h,00Ch,007h,0F0h,000h,000h
         DB      000h,000h,000h,000h,000h,000h,000h,000h
;
;16x16中文字形：／(全形), Data15->Data0,Scan0->Scan15
         DB      000h,000h,040h,000h,020h,000h,010h,000h
         DB      008h,000h,004h,000h,002h,000h,001h,000h
         DB      000h,080h,000h,040h,000h,020h,000h,010h
         DB      000h,008h,000h,004h,000h,002h,000h,000h
;
;16x16中文字形：（(全形), Data15->Data0,Scan0->Scan15
         DB      000h,000h,000h,000h,000h,000h,000h,000h
         DB      000h,000h,000h,000h,000h,000h,000h,000h
         DB      000h,000h,003h,080h,01Ch,070h,060h,00Ch
         DB      080h,002h,000h,000h,000h,000h,000h,000h
;
;16x16中文字形：）(全形), Data15->Data0,Scan0->Scan15
         DB      000h,000h,000h,000h,000h,000h,000h,000h
         DB      080h,002h,060h,00Ch,01Ch,070h,003h,080h
         DB      000h,000h,000h,000h,000h,000h,000h,000h
         DB      000h,000h,000h,000h,000h,000h,000h,000h
;
;16x16中文字形：Ｗ(全形), Data15->Data0,Scan0->Scan15
         DB      000h,000h,000h,004h,000h,01Ch,001h,0FCh
         DB      00Fh,0C4h,03Ch,000h,00Eh,004h,001h,09Ch
         DB      000h,0FCh,00Fh,0C4h,03Ch,000h,00Eh,000h
         DB      001h,0C4h,000h,03Ch,000h,004h,000h,004h
;
;16x16中文字形：一, Data15->Data0,Scan0->Scan15
         DB      000h,000h,001h,000h,001h,000h,001h,000h
         DB      001h,000h,001h,000h,001h,000h,001h,000h
         DB      001h,000h,001h,000h,001h,000h,001h,000h
         DB      001h,000h,001h,000h,001h,080h,001h,000h
;
;16x16中文字形：二, Data15->Data0,Scan0->Scan15
         DB      000h,000h,020h,000h,020h,008h,020h,008h
         DB      020h,008h,020h,008h,020h,008h,020h,008h
         DB      020h,008h,020h,008h,020h,008h,020h,008h
         DB      020h,008h,020h,00Ch,030h,008h,020h,000h
;
;16x16中文字形：三, Data15->Data0,Scan0->Scan15
         DB      000h,000h,040h,000h,040h,004h,041h,004h
         DB      041h,004h,041h,004h,041h,004h,041h,004h
         DB      041h,004h,041h,004h,041h,004h,041h,084h
         DB      041h,006h,040h,004h,060h,000h,040h,000h
;
;16x16中文字形：四, Data15->Data0,Scan0->Scan15
         DB      000h,000h,07Fh,0FCh,020h,008h,024h,008h
         DB      022h,008h,021h,088h,020h,078h,020h,008h
         DB      020h,008h,021h,0F8h,022h,008h,022h,008h
         DB      023h,088h,020h,008h,07Fh,0FCh,000h,008h
;
;16x16中文字形：五, Data15->Data0,Scan0->Scan15
         DB      000h,000h,040h,000h,040h,004h,040h,084h
         DB      040h,084h,078h,084h,047h,084h,040h,0FCh
         DB      040h,084h,040h,084h,040h,084h,040h,084h
         DB      07Fh,0C4h,040h,086h,060h,004h,040h,000h
;
;16x16中文字形：六, Data15->Data0,Scan0->Scan15
         DB      000h,000h,040h,010h,020h,010h,010h,010h
         DB      00Ch,010h,007h,010h,001h,010h,000h,010h
         DB      000h,01Eh,000h,012h,001h,010h,002h,010h
         DB      00Ch,010h,038h,010h,060h,018h,000h,010h
;
;16x16中文字形：七, Data15->Data0,Scan0->Scan15
         DB      000h,000h,000h,080h,000h,080h,000h,080h
         DB      000h,080h,000h,080h,03Fh,0FEh,040h,042h
         DB      040h,040h,040h,040h,040h,040h,040h,020h
         DB      040h,020h,040h,020h,078h,030h,020h,020h
;
;16x16中文字形：八, Data15->Data0,Scan0->Scan15
         DB      000h,000h,080h,000h,040h,000h,030h,000h
         DB      00Eh,000h,001h,0F8h,000h,00Ah,000h,002h
         DB      000h,002h,000h,0FFh,007h,002h,018h,000h
         DB      020h,000h,040h,000h,0C0h,000h,040h,000h
;
;16x16中文字形：九, Data15->Data0,Scan0->Scan15
         DB      000h,000h,080h,020h,040h,020h,030h,020h
         DB      00Ch,020h,003h,0E0h,000h,03Eh,000h,022h
         DB      000h,020h,000h,020h,07Fh,0F0h,080h,020h
         DB      080h,000h,080h,000h,0F0h,000h,040h,000h
;
;16x16中文字形：十, Data15->Data0,Scan0->Scan15
         DB      000h,000h,000h,080h,000h,080h,000h,080h
         DB      000h,080h,000h,080h,000h,080h,000h,080h
         DB      0FFh,0FEh,000h,082h,000h,080h,000h,080h
         DB      000h,080h,000h,080h,000h,0C0h,000h,080h
;
;16x16中文字形：日, Data15->Data0,Scan0->Scan15
         DB      000h,000h,000h,000h,000h,000h,0FFh,0FEh
         DB      041h,004h,041h,004h,041h,004h,041h,004h
         DB      041h,004h,041h,004h,041h,004h,041h,004h
         DB      0FFh,0FEh,000h,004h,000h,000h,000h,000h
;
;16x16中文字形：台, Data15->Data0,Scan0->Scan15
         DB      000h,000h,000h,040h,000h,0C0h,000h,040h
         DB      0FFh,060h,042h,050h,042h,048h,042h,026h
         DB      042h,022h,042h,020h,042h,020h,042h,028h
         DB      0FFh,010h,002h,030h,000h,060h,000h,0C0h
;
;16x16中文字形：南, Data15->Data0,Scan0->Scan15
         DB      000h,000h,000h,008h,0FFh,0E8h,000h,048h
         DB      002h,048h,00Ah,0C8h,00Bh,048h,00Ah,048h
         DB      07Eh,07Eh,00Ah,04Ah,00Bh,048h,00Ah,0C8h
         DB      042h,048h,0C0h,048h,07Fh,0ECh,000h,048h
;
;16x16中文字形：大, Data15->Data0,Scan0->Scan15
         DB      000h,000h,080h,020h,080h,020h,040h,020h
         DB      020h,020h,010h,020h,00Ch,020h,003h,020h
         DB      001h,0FEh,002h,022h,00Ch,020h,010h,020h
         DB      020h,020h,040h,020h,0C0h,030h,040h,020h
;
;16x16中文字形：村, Data15->Data0,Scan0->Scan15
         DB      000h,000h,004h,010h,003h,010h,000h,0D0h
         DB      0FFh,0FEh,001h,012h,006h,010h,000h,000h
         DB      000h,090h,003h,010h,026h,010h,040h,010h
         DB      0C0h,010h,07Fh,0FEh,000h,012h,000h,010h
;
;16x16中文字形：預, Data15->Data0,Scan0->Scan15
         DB      000h,000h,000h,084h,040h,094h,0C0h,094h
         DB      07Fh,0A4h,000h,094h,002h,08Eh,001h,0C4h
         DB      080h,000h,05Fh,0F4h,032h,0A4h,012h,0B4h
         DB      012h,0ACh,032h,0A4h,05Fh,0F6h,0C0h,024h
;
;16x16中文字形：審, Data15->Data0,Scan0->Scan15
         DB      000h,000h,004h,010h,004h,08Eh,004h,0A4h
         DB      0FAh,0A4h,0AAh,0E4h,0A9h,0A4h,0A8h,0A4h
         DB      0FFh,0F6h,0A9h,094h,0AAh,0D4h,0AAh,0B4h
         DB      0FAh,094h,004h,0C4h,004h,08Eh,004h,004h
;
;16x16中文字形：在, Data15->Data0,Scan0->Scan15
         DB      000h,000h,004h,010h,002h,010h,001h,010h
         DB      0FFh,0D0h,000h,030h,040h,01Eh,042h,012h
         DB      042h,010h,042h,010h,07Fh,0D0h,042h,050h
         DB      042h,010h,043h,010h,062h,018h,040h,010h
;
;16x16中文字形：場, Data15->Data0,Scan0->Scan15
         DB      000h,000h,008h,020h,018h,020h,00Fh,0FEh
         DB      004h,022h,00Ah,0A0h,028h,080h,024h,0BEh
         DB      053h,0AAh,04Eh,0AAh,022h,0AAh,052h,0AAh
         DB      0CEh,0BEh,042h,080h,03Eh,0C0h,000h,080h
;
;16x16中文字形：電, Data15->Data0,Scan0->Scan15
         DB      000h,000h,000h,020h,000h,01Ch,000h,0A8h
         DB      03Eh,0AAh,02Ah,0AAh,02Ah,0AAh,02Ah,00Ah
         DB      07Eh,0FEh,0AAh,00Ah,0AAh,0AAh,0AAh,0AAh
         DB      0BEh,0AAh,080h,0A8h,0F0h,01Ch,040h,008h
;
;16x16中文字形：子, Data15->Data0,Scan0->Scan15
         DB      000h,000h,001h,000h,001h,000h,001h,004h
         DB      001h,004h,021h,004h,041h,004h,0C1h,004h
         DB      07Fh,0E4h,001h,024h,001h,014h,001h,014h
         DB      001h,00Eh,001h,004h,001h,080h,001h,000h
;
;16x16中文字形：微, Data15->Data0,Scan0->Scan15
         DB      000h,000h,001h,010h,000h,088h,0FFh,0C6h
         DB      000h,032h,041h,010h,031h,07Ch,00Fh,020h
         DB      001h,03Eh,03Fh,020h,091h,07Ch,04Ah,000h
         DB      033h,0FEh,00Ch,012h,036h,010h,0C1h,0F0h
;
;16x16中文字形：腦, Data15->Data0,Scan0->Scan15
         DB      000h,000h,0E0h,000h,01Fh,0FEh,042h,024h
         DB      0C2h,024h,07Fh,0FEh,000h,000h,0FFh,018h
         DB      041h,066h,065h,082h,055h,058h,049h,066h
         DB      055h,002h,075h,018h,041h,066h,0FFh,002h
;
;16x16中文字形：苗, Data15->Data0,Scan0->Scan15
         DB      000h,000h,000h,008h,0FFh,0C8h,044h,088h
         DB      044h,088h,044h,0BEh,044h,08Ah,07Fh,088h
         DB      044h,088h,044h,088h,044h,0BEh,044h,08Ah
         DB      044h,088h,0FFh,0C8h,000h,08Ch,000h,008h
;
;16x16中文字形：栗, Data15->Data0,Scan0->Scan15
         DB      000h,000h,044h,004h,044h,004h,025h,0F4h
         DB      024h,094h,014h,094h,014h,0FCh,00Ch,094h
         DB      0FFh,094h,014h,094h,014h,0FCh,024h,094h
         DB      024h,094h,045h,0F4h,044h,006h,044h,004h
;
;16x16中文字形：永, Data15->Data0,Scan0->Scan15
         DB      000h,000h,020h,080h,020h,080h,010h,090h
         DB      00Ch,092h,023h,0D2h,040h,094h,0C0h,014h
         DB      07Fh,0F4h,000h,080h,003h,000h,004h,080h
         DB      008h,080h,010h,040h,030h,040h,010h,000h
;
;16x16中文字形：靖, Data15->Data0,Scan0->Scan15
         DB      000h,000h,010h,008h,037h,0E8h,010h,008h
         DB      00Fh,00Eh,008h,0EAh,004h,008h,000h,044h
         DB      0FFh,054h,015h,054h,015h,054h,015h,07Eh
         DB      055h,054h,0D5h,054h,07Fh,056h,000h,044h
;
;16x16中文字形：A(半形), Data15->Data0,Scan0->Scan15
         DB      020h,000h,03Ch,000h,023h,0E0h,002h,01Ch
         DB      023h,0E0h,03Ch,000h,020h,000h,000h,000h
;
;16x16中文字形：P(半形), Data15->Data0,Scan0->Scan15
         DB      020h,004h,03Fh,0FCh,021h,004h,001h,004h
         DB      001h,004h,000h,088h,000h,070h,000h,000h
;
;16x16中文字形：M(半形), Data15->Data0,Scan0->Scan15
         DB      020h,004h,03Fh,0FCh,020h,0E0h,00Fh,000h
         DB      020h,0E0h,03Fh,0FCh,020h,004h,000h,000h
;
;16x16中文字形：中, Data15->Data0,Scan0->Scan15
         DB      000h,000h,00Fh,0F0h,004h,020h
         DB      004h,020h,004h,020h,004h,020h,004h,020h
         DB      0FFh,0FEh,004h,022h,004h,020h,004h,020h
         DB      004h,020h,004h,020h,00Fh,0F0h,000h,020h
